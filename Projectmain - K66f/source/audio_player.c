#include "audio_player.h"
#include "fsl_dac.h"
#include "fsl_ftm.h"
#include "fsl_port.h"
#include "fsl_debug_console.h"
#include "clock_config.h"
/* * GenAI Declaration:
 * Claude was used to for the setting below:
 */
/* * 8000 Hz matches the sample rate generated by your Flask server.
 * If the audio sounds like slow-motion or chipmunks, adjust this!
 */
#define AUDIO_SAMPLE_RATE  8000U

static const uint8_t *g_audioData = NULL;
static volatile uint32_t g_audioLength = 0;
static volatile uint32_t g_audioIndex  = 0;
static volatile int g_playing = 0;

void FTM0_IRQHandler(void) {
    FTM_ClearStatusFlags(FTM0, kFTM_TimeOverflowFlag);

    if (g_playing && g_audioIndex < g_audioLength) {
        /* Scale 8-bit network audio (0-255) to 12-bit DAC (0-4095).
         * Shifting left by 4 is the same as multiplying by 16.
         */
        uint16_t dacVal = ((uint16_t)g_audioData[g_audioIndex]) << 4;
        DAC_SetBufferValue(DAC0, 0U, dacVal);
        g_audioIndex++;
    } else if (g_playing) {
        /* Audio finished. Return DAC to midpoint to prevent speaker pops. */
        DAC_SetBufferValue(DAC0, 0U, 2048U);
        g_playing = 0;
        FTM_DisableInterrupts(FTM0, kFTM_TimeOverflowInterruptEnable);
        FTM_StopTimer(FTM0);
    }
}

void Audio_Player_Init(void) {
    /* Initialize DAC */
    dac_config_t dacConfig;
    DAC_GetDefaultConfig(&dacConfig);
    dacConfig.referenceVoltageSource = kDAC_ReferenceVoltageSourceVref2;
    dacConfig.enableLowPowerMode = false;

    DAC_Init(DAC0, &dacConfig);
    DAC_Enable(DAC0, true);
    DAC_SetBufferValue(DAC0, 0U, 2048U);

    /* Initialize FTM Timer for Sample Rate */
    ftm_config_t ftmConfig;
    FTM_GetDefaultConfig(&ftmConfig);
    ftmConfig.prescale = kFTM_Prescale_Divide_1;
    FTM_Init(FTM0, &ftmConfig);

    uint32_t ftmClk = CLOCK_GetFreq(kCLOCK_BusClk);
    uint32_t modVal = (ftmClk / AUDIO_SAMPLE_RATE) - 1U;

    FTM0->MOD = modVal;
    FTM0->CNT = 0U;

    EnableIRQ(FTM0_IRQn);
    NVIC_SetPriority(FTM0_IRQn, 2);

    PRINTF("[AUDIO] DAC0 + FTM0 initialized at %d Hz (MOD=%d)\r\n", AUDIO_SAMPLE_RATE, modVal);
}

void Audio_Player_Play(const uint8_t *data, uint32_t length) {
    FTM_StopTimer(FTM0);
    FTM_DisableInterrupts(FTM0, kFTM_TimeOverflowInterruptEnable);

    /* A valid WAV file must be larger than its 44-byte header */
    if (length <= 44 || data == NULL) {
        PRINTF("[AUDIO] Error: File too small or invalid!\r\n");
        return;
    }

    /* Skip the 44-byte WAV header and point directly to the raw PCM audio bytes */
    g_audioData   = data + 44;
    g_audioLength = length - 44;
    g_audioIndex  = 0;
    g_playing     = 1;

    PRINTF("[AUDIO] Streaming %d bytes to Speaker (~%d ms)...\r\n", g_audioLength, (g_audioLength * 1000) / AUDIO_SAMPLE_RATE);

    FTM0->CNT = 0U;
    FTM_EnableInterrupts(FTM0, kFTM_TimeOverflowInterruptEnable);
    FTM_StartTimer(FTM0, kFTM_SystemClock);
}

int Audio_Player_IsBusy(void) {
    return g_playing;
}
