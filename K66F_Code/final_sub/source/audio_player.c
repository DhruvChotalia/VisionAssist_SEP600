/**
 * audio_player.c — VisionAssist K66F Audio Playback
 * ===================================================
 *
 * Uses DAC0 to output 8-bit unsigned PCM audio and FTM0 as the sample-rate
 * timer.  The FTM0 overflow ISR outputs one sample per tick.
 *
 * Sample format (must match Flask server):
 *   8-bit unsigned PCM, 8000 Hz, Mono.
 *   Transmitted over UART as a standard RIFF/WAV file (44-byte header + PCM).
 *
 * FIX B — WAV header skip (one pass only)
 * ─────────────────────────────────────────
 * Previously Comm_Task stripped the 44-byte RIFF header before calling
 * Audio_Player_Play(), and then Audio_Player_Play() stripped it again,
 * discarding the first 44 bytes of real PCM audio.
 *
 * The fix is a single, well-defined contract:
 *   • Comm_Task passes the FULL WAV buffer (pointer = audioBuffer,
 *     length = total received bytes including the header).
 *   • Audio_Player_Play() is the sole place the header is skipped.
 *
 * The guard now checks (length > WAV_HEADER_BYTES) which is the correct
 * minimum — the file must contain at least one byte of PCM beyond the header.
 */

#include "audio_player.h"
#include "fsl_dac.h"
#include "fsl_ftm.h"
#include "fsl_port.h"
#include "fsl_debug_console.h"
#include "clock_config.h"

/*
 * 8000 Hz matches the sample rate generated by the Flask server.
 * If audio sounds like slow-motion, increase this value.
 * If audio sounds like chipmunks, decrease it.
 */
#define AUDIO_SAMPLE_RATE  8000U

/* WAV header size (standard RIFF/WAV) */
#define WAV_HEADER_BYTES   44U

static const uint8_t    *g_audioData   = NULL;
static volatile uint32_t g_audioLength = 0;
static volatile uint32_t g_audioIndex  = 0;
static volatile int       g_playing    = 0;

/* ═══════════════════════════════════════════════════════════════════════════
 * FTM0 ISR — fires at AUDIO_SAMPLE_RATE Hz
 * ═══════════════════════════════════════════════════════════════════════════ */
void FTM0_IRQHandler(void)
{
    FTM_ClearStatusFlags(FTM0, kFTM_TimeOverflowFlag);

    if (g_playing && g_audioIndex < g_audioLength) {
        /*
         * Scale 8-bit unsigned PCM (0–255) to 12-bit DAC (0–4095).
         * Left-shifting by 4 is equivalent to multiplying by 16.
         */
        uint16_t dacVal = ((uint16_t)g_audioData[g_audioIndex]) << 4;
        DAC_SetBufferValue(DAC0, 0U, dacVal);
        g_audioIndex++;
    } else if (g_playing) {
        /* Playback finished — park DAC at mid-rail to silence speaker pops */
        DAC_SetBufferValue(DAC0, 0U, 2048U);
        g_playing = 0;
        FTM_DisableInterrupts(FTM0, kFTM_TimeOverflowInterruptEnable);
        FTM_StopTimer(FTM0);
    }
}

/* ═══════════════════════════════════════════════════════════════════════════
 * Audio_Player_Init
 * ═══════════════════════════════════════════════════════════════════════════ */
void Audio_Player_Init(void)
{
    /* ── DAC0 init ────────────────────────────────────────────────────────── */
    dac_config_t dacConfig;
    DAC_GetDefaultConfig(&dacConfig);
    dacConfig.referenceVoltageSource = kDAC_ReferenceVoltageSourceVref2;
    dacConfig.enableLowPowerMode     = false;

    DAC_Init(DAC0, &dacConfig);
    DAC_Enable(DAC0, true);
    DAC_SetBufferValue(DAC0, 0U, 2048U);   /* mid-rail — silent */

    /* ── FTM0 init (sample-rate timer) ───────────────────────────────────── */
    ftm_config_t ftmConfig;
    FTM_GetDefaultConfig(&ftmConfig);
    ftmConfig.prescale = kFTM_Prescale_Divide_1;
    FTM_Init(FTM0, &ftmConfig);

    uint32_t ftmClk = CLOCK_GetFreq(kCLOCK_BusClk);
    uint32_t modVal = (ftmClk / AUDIO_SAMPLE_RATE) - 1U;

    FTM0->MOD = modVal;
    FTM0->CNT = 0U;

    EnableIRQ(FTM0_IRQn);
    NVIC_SetPriority(FTM0_IRQn, 2);

    PRINTF("[AUDIO] DAC0 + FTM0 initialized at %u Hz (MOD=%u)\r\n",
           AUDIO_SAMPLE_RATE, modVal);
}

/* ═══════════════════════════════════════════════════════════════════════════
 * Audio_Player_Play
 *
 * Parameters
 * ──────────
 *   data   — pointer to the START of the full WAV buffer (includes header).
 *             Comm_Task passes audioBuffer directly; do NOT pre-strip the header.
 *   length — total byte count received, including the 44-byte RIFF header.
 *
 * Fix B: this function is the single place the WAV header is skipped.
 *   g_audioData   = data + WAV_HEADER_BYTES   (first PCM sample)
 *   g_audioLength = length - WAV_HEADER_BYTES  (PCM byte count)
 * ═══════════════════════════════════════════════════════════════════════════ */
void Audio_Player_Play(const uint8_t *data, uint32_t length)
{
    /* Stop any in-progress playback cleanly before reconfiguring */
    FTM_StopTimer(FTM0);
    FTM_DisableInterrupts(FTM0, kFTM_TimeOverflowInterruptEnable);

    /* Validate: must contain at least one byte of PCM beyond the header */
    if (data == NULL || length <= WAV_HEADER_BYTES) {
        PRINTF("[AUDIO] Error: buffer NULL or too small (length=%u).\r\n", length);
        return;
    }

    /*
     * Skip the 44-byte RIFF/WAV header.
     * audioBuffer[0..43]  = RIFF header (ignored)
     * audioBuffer[44..]   = 8-bit unsigned PCM @ 8000 Hz mono
     */
    g_audioData   = data + WAV_HEADER_BYTES;
    g_audioLength = length - WAV_HEADER_BYTES;
    g_audioIndex  = 0;
    g_playing     = 1;

    PRINTF("[AUDIO] Playing %u PCM bytes (~%u ms).\r\n",
           g_audioLength,
           (g_audioLength * 1000U) / AUDIO_SAMPLE_RATE);

    /* Start the sample-rate timer — ISR drives the rest */
    FTM0->CNT = 0U;
    FTM_EnableInterrupts(FTM0, kFTM_TimeOverflowInterruptEnable);
    FTM_StartTimer(FTM0, kFTM_SystemClock);
}

/* ═══════════════════════════════════════════════════════════════════════════
 * Audio_Player_IsBusy
 * ═══════════════════════════════════════════════════════════════════════════ */
int Audio_Player_IsBusy(void)
{
    return g_playing;
}
